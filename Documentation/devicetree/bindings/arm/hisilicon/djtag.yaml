## drivers/mtd/nand/fmc100_nand/Kconfig
```kconfig
#
# drivers/mtd/nand/fmc100_nand/Kconfig
#

menuconfig MTD_NAND_FMC100
	tristate "Vendor Flash Memory Controller v100 Nand devices support"
	depends on MFD_BSP_FMC && !MTD_SPI_NAND_BSP
	select MISC_FILESYSTEMS
	select MTD_BLOCK
	select YAFFS_FS
	select YAFFS_YAFFS2
	help
	  Vendor Flash Memory Controller version 100 is called fmc100 for
	  short. The controller support DMA transfers while reading or writing
	  the Nand flash.

if MTD_NAND_FMC100

config FMC100_NAND_EDO_MODE
	bool "the Extended Data Out(EDO) mode"
	help
	  In Extended data out (EDO), a new data cycle is started while the data
	  output of the previous cycle is still active. This process of cycle
	  overlapping, called pipelining, increases processing speed by about
	  10 nanoseconds per cycle,increasing computer performance by about 5
	  percent compared to performance using FMP.

config RW_H_WIDTH
	int "the width of Read/Write HIGH Hold Time (0 to 15)"
	range 0 15
	help
	  the Read/Write HIGH Hold Time of nand flash

config R_L_WIDTH
	int "the Read pulse width (0 to 15)"
	range 0 15
	help
	  the Read/Write LOW Hold Time of nand flash

config W_L_WIDTH
	int "the Write pulse width (0 to 15)"
	range 0 15
	help
	  the Read/Write LOW Hold Time of nand flash

endif # End of MTD_NAND_FMC100
```

## drivers/mtd/spi-nor/controllers/Kconfig
```kconfig
# SPDX-License-Identifier: GPL-2.0-only
config SPI_ASPEED_SMC
	tristate "Aspeed flash controllers in SPI mode"
	depends on ARCH_ASPEED || COMPILE_TEST
	depends on HAS_IOMEM && OF
	help
	  This enables support for the Firmware Memory controller (FMC)
	  in the Aspeed AST2500/AST2400 SoCs when attached to SPI NOR chips,
	  and support for the SPI flash memory controller (SPI) for
	  the host firmware. The implementation only supports SPI NOR.

config SPI_HISI_SFC
	tristate "Hisilicon FMC SPI NOR Flash Controller(SFC)"
	depends on ARCH_HISI || COMPILE_TEST
	depends on HAS_IOMEM
	help
	  This enables support for HiSilicon FMC SPI NOR flash controller.
config SPI_BSP_SFC
	tristate "Vendor FMCV100 SPI-NOR Flash Controller(SFC)"
	depends on ARCH_BSP || COMPILE_TEST
	depends on HAS_IOMEM && HAS_DMA
	help
	  This enables support for vendor flash memory contrller ver100
	  (FMCV100)- SPI-NOR flash controller.

config SPI_NXP_SPIFI
	tristate "NXP SPI Flash Interface (SPIFI)"
	depends on OF && (ARCH_LPC18XX || COMPILE_TEST)
	depends on HAS_IOMEM
	help
	  Enable support for the NXP LPC SPI Flash Interface controller.

	  SPIFI is a specialized controller for connecting serial SPI
	  Flash. Enable this option if you have a device with a SPIFI
	  controller and want to access the Flash as a mtd device.

config SPI_INTEL_SPI
	tristate

config SPI_INTEL_SPI_PCI
	tristate "Intel PCH/PCU SPI flash PCI driver (DANGEROUS)"
	depends on X86 && PCI
	select SPI_INTEL_SPI
	help
	  This enables PCI support for the Intel PCH/PCU SPI controller in
	  master mode. This controller is present in modern Intel hardware
	  and is used to hold BIOS and other persistent settings. Using
	  this driver it is possible to upgrade BIOS directly from Linux.

	  Say N here unless you know what you are doing. Overwriting the
	  SPI flash may render the system unbootable.

	  To compile this driver as a module, choose M here: the module
	  will be called intel-spi-pci.

config SPI_INTEL_SPI_PLATFORM
	tristate "Intel PCH/PCU SPI flash platform driver (DANGEROUS)"
	depends on X86
	select SPI_INTEL_SPI
	help
	  This enables platform support for the Intel PCH/PCU SPI
	  controller in master mode. This controller is present in modern
	  Intel hardware and is used to hold BIOS and other persistent
	  settings. Using this driver it is possible to upgrade BIOS
	  directly from Linux.

	  Say N here unless you know what you are doing. Overwriting the
	  SPI flash may render the system unbootable.

	  To compile this driver as a module, choose M here: the module
	  will be called intel-spi-platform.
config MTD_SPI_IDS
    bool "SPI Flash Timing Cycles Probe Function"
    default n
    help
      This option enables sfc300/sfc350 used spi flash timing cylces
      probe function.
      If your use sfc300 and sfc350, this function should be select.

config CLOSE_SPI_8PIN_4IO
	bool "Close SPI device Quad SPI mode for some 8PIN chip"
	default y if ARCH_BSP
	help
	fmcv100 and sfcv350 support Quad SPI mode and Quad&addr SPI mode.
	But some 8PIN chip does not support this mode when HOLD/IO3 PIN
	was used by reset operation.
	Usually, your should not config this option.

config BSP_SPI_BLOCK_PROTECT
	bool "Vendor Spi Nor Device BP(Block Protect) Support"
	depends on SPI_BSP_SFC
	default y if SPI_BSP_SFC
	help
	  SFC supports BP(Block Protect) feature to preestablish a series
	  area to avoid writing and erasing, except to reading. With this macro
	  definition we can get the BP info which was setted before. The
	  BOTTOM/TOP bit is setted to BOTTOM, it means the lock area starts
	  from 0 address.
```

## drivers/net/ethernet/vendor/Kconfig
```kconfig
#
# VENDOR device configuration
#

config NET_VENDOR_VENDOR
	bool "Vendor devices"
	default y
	depends on OF || ACPI
	depends on ARM || ARM64 || COMPILE_TEST
	help
	  If you have a network (Ethernet) card belonging to this class, say Y.

	  Note that the answer to this question doesn't directly affect the
	  kernel: saying N will just cause the configurator to skip all
	  the questions about Vendor devices. If you say Y, you will be asked
	  for your specific card in the following questions.

if NET_VENDOR_VENDOR
source "drivers/net/ethernet/vendor/gmac/Kconfig"
endif # NET_VENDOR_VENDOR
```

## drivers/phy/vendor/Kconfig
```kconfig
menuconfig VENDOR_USB_PHY
	tristate "Vendor USB support"

if VENDOR_USB_PHY

source "drivers/phy/vendor/usb/Kconfig"

endif # VENDOR_USB_PHY
```

## drivers/phy/vendor/usb/Kconfig
```kconfig
#
# Phy drivers for Vendor platforms
#
config PHY_BSP_USB2
	bool
	depends on (!ARCH_HI3559AV100 && !ARCH_HI3569V100 && !ARCH_HI3516EV200 && \
		!ARCH_HI3516EV300 && !ARCH_HI3518EV300 && !ARCH_HI3516DV200 && \
		!ARCH_HI3519DV500_FAMILY && !ARCH_SD3491V100)
	default y
	help
	  Support for PHY on Vendor Socs. This Phy supports
	  USB 1.5Mb/s, USB 12Mb/s, USB 480Mb/s speeds. It suppots one
	  USB host port to accept one USB device. Support init the phy
	  and adjust phy Eye Diagram.

config PHY_BSP_USB3
	bool
	depends on (ARCH_HI3519AV100 || ARCH_HI3556AV100 || ARCH_HI3559AV100 || \
		ARCH_HI3569V100 || ARCH_HI3568V100 || ARCH_HI3531DV200 || \
		ARCH_HI3535AV100 || ARCH_HI3519DV500_FAMILY || ARCH_SD3491V100)
	default y
	help
	  Support for PHY on Vendor Socs. This Phy supports
	  USB3.0 and Compatible with USB2.0. It suppots one
	  USB host port to accept one USB device. Support init the phy
	  and adjust phy Eye Diagram.

config BSP_USB_PHY
	bool "Vendor USB PHY driver"
	depends on (!ARCH_HI3516EV200 && !ARCH_HI3516EV300 && !ARCH_HI3518EV300 && \
		!ARCH_HI3516DV200)
	default y
	help
	  Support for PHY on Vendor Socs. This Phy supports
	  USB 1.5Mb/s, USB 12Mb/s, USB 480Mb/s speeds. It suppots one
	  USB host port to accept one USB device. Support init the phy
	  and adjust phy Eye Diagram.

config PHY_BSP_XVP_USB2
	tristate "Vendor XVP USB2 PHY Driver"
	depends on (ARCH_HI3516EV200 || ARCH_HI3516EV300 || ARCH_HI3518EV300 || \
		ARCH_HI3516DV200)
	select GENERIC_PHY
	default y
	help
	  Support for PHY on Vendor Socs. This Phy supports
	  USB 1.5Mb/s, USB 12Mb/s, USB 480Mb/s speeds. It suppots one
	  USB host port to accept one USB device. Support init the phy
	  and adjust phy Eye Diagram.

menuconfig USB_MODE_OPTION
	bool "Vendor USB related configuration"
	depends on (!ARCH_HI3516EV200 && !ARCH_HI3516EV300 && !ARCH_HI3518EV300 && \
		!ARCH_HI3516DV200 && !ARCH_HI3531DV200 && !ARCH_HI3535AV100 &&	\
		!ARCH_HI3521DV200 && !ARCH_HI3520DV500 && !ARCH_HI3536CV200)

if USB_MODE_OPTION

config USB_DRD0_IN_HOST
	bool "USB DRD0 Mode Select HOST"
	help
	  Select whether the USB drd0 is working in host mode.

config USB_DRD0_IN_DEVICE
	bool "USB DRD0 Mode Select DEVICE"
	depends on !USB_DRD0_IN_HOST
	depends on (!ARCH_HI3531DV200 && !ARCH_HI3535AV100 && !ARCH_HI3521DV200 && \
		!ARCH_HI3520DV500 && !ARCH_HI3536CV200)
	help
	  Select whether the USB drd0 is working in device mode.

config USB_DRD1_IN_HOST
	bool "USB DRD1 Mode Select HOST"
	depends on (ARCH_HI3519AV100 || ARCH_HI3556AV100 || ARCH_HI3559AV100 ||	\
		ARCH_HI3569V100 || ARCH_HI3568V100)
	help
	  Select whether the USB drd1 is working in host mode.

config USB_DRD1_IN_DEVICE
	bool "USB DRD1 Mode Select DEVICE"
	depends on (!USB_DRD1_IN_HOST && !USB_DRD0_IN_DEVICE)
	depends on (ARCH_HI3519AV100 || ARCH_HI3556AV100 || ARCH_HI3559AV100 || \
		ARCH_HI3569V100 || ARCH_HI3568V100)
	help
	  Select whether the USB drd1 is working in device mode.

endif # USB_MODE_OPTION
```

## drivers/tee/optee/Kconfig
```kconfig
# SPDX-License-Identifier: GPL-2.0-only
# OP-TEE Trusted Execution Environment Configuration
config OPTEE
	tristate "OP-TEE"
	depends on HAVE_ARM_SMCCC
	depends on MMU
	help
	  This implements the OP-TEE Trusted Execution Environment (TEE)
	  driver.

config OPTEE_SHM_NUM_PRIV_PAGES
	int "Private Shared Memory Pages"
	default 1
	depends on OPTEE
	help
	  This sets the number of private shared memory pages to be
	  used by OP-TEE TEE driver.

config SYNC_OPTEE_MEMORY_LAYOUT
	bool "Synchronizing OP-TEE memory layout"
	depends on OPTEE
	help
	  This synchronize OP-TEE memory layout at compile time.

config OPTEE_DIR
	string "OP-TEE directory"
	default ""
	depends on SYNC_OPTEE_MEMORY_LAYOUT
```

## drivers/vdmav100/Kconfig
```kconfig
menuconfig VDMA_V100
	tristate "Vendor VDMA Controller V100"
	depends on ARCH_HI3556AV100 || ARCH_HI3519AV100 || ARCH_HI3568V100
	default n if ARCH_HI3556AV100 || ARCH_HI3519AV100 || ARCH_HI3568V100
	help
	  This is the driver for Vendor VDMA controoller
	  IP.

if VDMA_V100

config VDMA_CHN_NUM
	int "VDMAV100 max channel number"
	default 32

config VDMA_TRANSFER_THRESHOLD
        int "VDMA data transfer threshold KBytes"
        range 4 16384
        default "128" if (ARCH_HI3556AV100 || ARCH_HI3519AV100 || ARCH_HI3568V100)

config VDMA_MISC_DEV
	bool "VDMAV100 misc dev"
	default y if (ARCH_HI3556AV100 || ARCH_HI3519AV100 || ARCH_HI3568V100)
	depends on VDMA_V100


endif
```

## drivers/vendor/Kconfig
```kconfig
menu "Vendor driver support"

source "drivers/vendor/cma/Kconfig"
source "drivers/vendor/npu/Kconfig"
source "drivers/vendor/usb/Kconfig"
source "drivers/vendor/ups_phy/Kconfig"
source "drivers/vendor/basedrv_clk/Kconfig"
source "drivers/vendor/mmc/Kconfig"

endmenu
```

## drivers/vendor/mmc/Kconfig
```kconfig
#
# MMC/SD host controller drivers
#

config MMC_SDHCI_NEBULA
	tristate "SDHCI nebula support"
	depends on MMC && MMC_SDHCI
	help
	  This selects the SDHCI nebula support.

	  If you have a controller with this interface, say Y or M here.

	  If unsure, say N.

config MMC_QUICKBOOT
	tristate "SDHCI support quick boot on the Vendor SoC"
	depends on MMC_SDHCI_PLTFM && ((MMC_SDHCI_NEBULA = y) || (MMC_SDHCI_SOCT = y))
	help
	  This selects the SDHCI quick boot support for Vendor System-on-Chip devices.

	  If you want to support this feature, say Y here.

	  If unsure, say N.
```

## drivers/vendor/npu/Kconfig
```kconfig
config VENDOR_NPU
	bool "Vendor NPU Feature"
	default n
	help
	  Support Vendor NPU.
```

## drivers/vendor/ups_phy/Kconfig
```kconfig
menu "Wing UPS Phy"

config WING_UPS_PHY
    tristate "Support Wing UPS Phy"
	select GENERIC_PHY
	help
	  Say Y or M here if you want support Wing UPS phy.

if WING_UPS_PHY
config WING_UPS_XVP_PHY
	bool "Support UPS Xvp Phy"
	help
	  Say Y here if you want to support xvp phy.

config WING_UPS_NANO_PHY
	bool "Support UPS Nano Phy"
	help
	  Say Y here if you want to support nano phy.

config WING_UPS_MISSILE_PHY
	bool "Support UPS Missile Phy"
	help
	  Say Y here if you want to support missile phy.

endif #WING_UPS_PHY

endmenu
```

## drivers/vendor/usb/Kconfig
```kconfig
config USB_WING
    tristate "Wing USB controller"
    select EXTCON
	select USB_DWC3_DUAL_ROLE
	help
	  Say Y or M here if you want support Wing USB controller.
```

## init/Kconfig.timestamp
```kconfig
config CMD_TIMESTAMP
	bool "Show timing information that stamped during booting stage in the start_kernel"
	default n
	help
	  The timestamp is always recorded internally, you can use 'dmesg | grep timestamp' command to check the details.
```
