## Documentation/devicetree/bindings/arm/hisilicon/djtag.yaml
```yaml
# SPDX-License-Identifier: (GPL-2.0-only OR BSD-2-Clause)
%YAML 1.2
---
$id: http://devicetree.org/schemas/arm/hisilicon/djtag.yaml#
$schema: http://devicetree.org/meta-schemas/core.yaml#

title: Hisilicon DJTAG r/w interfaces

maintainers:
  - Wei Xu <xuwei5@hisilicon.com>

properties:
  compatible:
    enum:
      - hisilicon,hip05-djtag
      - hisilicon,hi1382-djtag
      - hisilicon,sd6801-djtag
      - hisilicon,djtag-v1
      - hisilicon,djtag-v2
      - hisilicon,djtag-v2-ex

  syscon:
    description: implement r/w interfaces via which sysctrl node.
    $ref: /schemas/types.yaml#/definitions/phandle

  djtag-mutex-access-protection:
    description: |
      Present if djtag need add mutex access protection to fix conflict with
      firmware(like M3).
    $ref: /schemas/types.yaml#/definitions/flag

required:
  - compatible
  - syscon

additionalProperties: false

examples:
  - |
    /* If it have multi dies, set like below.
     *
     * We need sysctrl node for its register address and "syscon",
     * but we don't implement sysctrl driver and don't care about
     * what compatible it is.
     */

    /* for Hisilicon P660(hip05) or Hi1610 */
    pa_sysctrl: system-controller@40010000 {
        compatible = "hisilicon,peri-subctrl", "syscon";
        reg = <0x40010000 0x10000>;
    };

    pc_sysctrl: system-controller@60010000 {
        compatible = "hisilicon,peri-subctrl", "syscon";
        reg = <0x60010000 0x10000>;
    };

    djtag0 {
        compatible = "hisilicon,hip05-djtag";
        syscon = <&pa_sysctrl>;
    };

    djtag1 {
        compatible = "hisilicon,hip05-djtag";
        syscon = <&pc_sysctrl>;
    };

    /* for Hisilicon Hi1382(hi1382) */
    pc_sysctrl_f1010000: system-controller@f1010000 {
        compatible = "hisilicon,peri-subctrl", "syscon";
        reg = <0xf1010000 0x10000>;
    };

    djtag2 {
        compatible = "hisilicon,hi1382-djtag";
        syscon = <&pc_sysctrl_f1010000>;
    };
...
```

## arch/arm64/configs/hi3519dv500_emmc_tee_defconfig
```kconfig
# CONFIG_SWAP is not set
CONFIG_SYSVIPC=y
CONFIG_USELIB=y
CONFIG_LOG_BUF_SHIFT=14
CONFIG_NAMESPACES=y
CONFIG_RELAY=y
# CONFIG_FHANDLE is not set
CONFIG_BPF_SYSCALL=y
CONFIG_USERFAULTFD=y
CONFIG_EMBEDDED=y
# CONFIG_COMPAT_BRK is not set
CONFIG_ARCH_BSP=y
CONFIG_ARCH_HI3519DV500=y
CONFIG_SCHED_MC=y
CONFIG_NR_CPUS=2
CONFIG_HZ_100=y
CONFIG_CMDLINE="mem=128M console=ttyAMA0,115200 console=ttyMTD,blackbox"
# CONFIG_EFI is not set
CONFIG_BUILD_ARM64_APPENDED_DTB_IMAGE=y
CONFIG_BUILD_ARM64_APPENDED_DTB_IMAGE_NAMES="vendor/hi3519dv500-demb-emmc-tee"
CONFIG_CPU_FREQ=y
CONFIG_CPU_FREQ_STAT=y
CONFIG_CPU_FREQ_DEFAULT_GOV_USERSPACE=y
CONFIG_CPU_FREQ_GOV_PERFORMANCE=y
CONFIG_CPU_FREQ_GOV_POWERSAVE=y
CONFIG_CPU_FREQ_GOV_ONDEMAND=y
CONFIG_CPU_FREQ_GOV_CONSERVATIVE=y
CONFIG_CPUFREQ_DT=y
# CONFIG_SECCOMP is not set
CONFIG_MODULES=y
CONFIG_MODULE_UNLOAD=y
CONFIG_PARTITION_ADVANCED=y
CONFIG_CMDLINE_PARTITION=y
CONFIG_KSM=y
CONFIG_CMA=y
CONFIG_NET=y
CONFIG_PACKET=y
CONFIG_UNIX=y
CONFIG_INET=y
CONFIG_IP_MULTICAST=y
CONFIG_IPV6_ROUTER_PREF=y
CONFIG_IPV6_SIT=m
CONFIG_NETFILTER=y
CONFIG_PCI=y
CONFIG_PCIEPORTBUS=y
# CONFIG_PCIEASPM is not set
CONFIG_UEVENT_HELPER=y
CONFIG_UEVENT_HELPER_PATH="/sbin/hotplug"
CONFIG_DEVTMPFS=y
CONFIG_DEVTMPFS_MOUNT=y
# CONFIG_PREVENT_FIRMWARE_BUILD is not set
CONFIG_BLK_DEV_LOOP=y
CONFIG_BLK_DEV_RAM=y
CONFIG_BLK_DEV_RAM_SIZE=65536
CONFIG_SCSI=y
CONFIG_BLK_DEV_SD=y
CONFIG_NETDEVICES=y
# CONFIG_NET_VENDOR_3COM is not set
# CONFIG_NET_VENDOR_ADAPTEC is not set
# CONFIG_NET_VENDOR_AGERE is not set
# CONFIG_NET_VENDOR_ALACRITECH is not set
# CONFIG_NET_VENDOR_ALTEON is not set
# CONFIG_NET_VENDOR_AMAZON is not set
# CONFIG_NET_VENDOR_AMD is not set
# CONFIG_NET_VENDOR_AQUANTIA is not set
# CONFIG_NET_VENDOR_ARC is not set
# CONFIG_NET_VENDOR_ATHEROS is not set
# CONFIG_NET_VENDOR_AURORA is not set
# CONFIG_NET_VENDOR_BROADCOM is not set
# CONFIG_NET_VENDOR_BROCADE is not set
# CONFIG_NET_VENDOR_CADENCE is not set
# CONFIG_NET_VENDOR_CAVIUM is not set
# CONFIG_NET_VENDOR_CHELSIO is not set
# CONFIG_NET_VENDOR_CISCO is not set
# CONFIG_NET_VENDOR_CORTINA is not set
# CONFIG_NET_VENDOR_DEC is not set
# CONFIG_NET_VENDOR_DLINK is not set
# CONFIG_NET_VENDOR_EMULEX is not set
# CONFIG_NET_VENDOR_EZCHIP is not set
# CONFIG_NET_VENDOR_HISILICON is not set
# CONFIG_NET_VENDOR_HUAWEI is not set
# CONFIG_NET_VENDOR_INTEL is not set
CONFIG_ETH_GMAC=y
CONFIG_GMAC_DDR_64BIT=y
# CONFIG_NET_VENDOR_MARVELL is not set
# CONFIG_NET_VENDOR_MELLANOX is not set
# CONFIG_NET_VENDOR_MICREL is not set
# CONFIG_NET_VENDOR_MICROCHIP is not set
# CONFIG_NET_VENDOR_MICROSEMI is not set
# CONFIG_NET_VENDOR_MYRI is not set
# CONFIG_NET_VENDOR_NATSEMI is not set
# CONFIG_NET_VENDOR_NETERION is not set
# CONFIG_NET_VENDOR_NETRONOME is not set
# CONFIG_NET_VENDOR_NI is not set
# CONFIG_NET_VENDOR_NVIDIA is not set
# CONFIG_NET_VENDOR_OKI is not set
# CONFIG_NET_VENDOR_PACKET_ENGINES is not set
# CONFIG_NET_VENDOR_QLOGIC is not set
# CONFIG_NET_VENDOR_QUALCOMM is not set
# CONFIG_NET_VENDOR_RDC is not set
# CONFIG_NET_VENDOR_REALTEK is not set
# CONFIG_NET_VENDOR_RENESAS is not set
# CONFIG_NET_VENDOR_ROCKER is not set
# CONFIG_NET_VENDOR_SAMSUNG is not set
# CONFIG_NET_VENDOR_SEEQ is not set
# CONFIG_NET_VENDOR_SOLARFLARE is not set
# CONFIG_NET_VENDOR_SILAN is not set
# CONFIG_NET_VENDOR_SIS is not set
# CONFIG_NET_VENDOR_SMSC is not set
# CONFIG_NET_VENDOR_SOCIONEXT is not set
# CONFIG_NET_VENDOR_STMICRO is not set
# CONFIG_NET_VENDOR_SUN is not set
# CONFIG_NET_VENDOR_SYNOPSYS is not set
# CONFIG_NET_VENDOR_TEHUTI is not set
# CONFIG_NET_VENDOR_TI is not set
# CONFIG_NET_VENDOR_VIA is not set
# CONFIG_NET_VENDOR_WIZNET is not set
CONFIG_MDIO_VENDOR_GEMAC=y
# CONFIG_WLAN is not set
CONFIG_INPUT_MOUSEDEV=y
CONFIG_INPUT_MOUSEDEV_PSAUX=y
CONFIG_INPUT_JOYDEV=y
CONFIG_INPUT_EVDEV=y
CONFIG_INPUT_JOYSTICK=y
CONFIG_INPUT_MISC=y
CONFIG_INPUT_UINPUT=y
CONFIG_GAMEPORT=y
# CONFIG_LEGACY_PTYS is not set
CONFIG_SERIAL_AMBA_PL011=y
CONFIG_SERIAL_AMBA_PL011_CONSOLE=y
# CONFIG_HW_RANDOM is not set
# CONFIG_I2C_COMPAT is not set
CONFIG_I2C_CHARDEV=y
# CONFIG_I2C_HELPER_AUTO is not set
CONFIG_I2C_BSP=y
CONFIG_SPI=y
CONFIG_SPI_PL022=y
CONFIG_SPI_SPIDEV=y
CONFIG_PINCTRL_SINGLE=y
CONFIG_GPIOLIB=y
CONFIG_GPIO_SYSFS=y
CONFIG_GPIO_GENERIC_PLATFORM=y
CONFIG_GPIO_PL061=y
# CONFIG_HWMON is not set
CONFIG_MFD_BSP_FMC=y
CONFIG_MFD_SYSCON=y
CONFIG_REGULATOR=y
# CONFIG_MEDIA_CEC_SUPPORT is not set
CONFIG_MEDIA_SUPPORT=y
CONFIG_MEDIA_SUBDRV_AUTOSELECT=y
# CONFIG_MEDIA_CONTROLLER is not set
CONFIG_MEDIA_USB_SUPPORT=y
CONFIG_USB_VIDEO_CLASS=y
# CONFIG_RADIO_ADAPTERS is not set
CONFIG_FB=y
CONFIG_SOUND=y
CONFIG_SND=y
CONFIG_HID_A4TECH=y
CONFIG_HID_APPLE=y
CONFIG_HID_BELKIN=y
CONFIG_HID_CHERRY=y
CONFIG_HID_CHICONY=y
CONFIG_HID_CYPRESS=y
CONFIG_HID_EZKEY=y
CONFIG_HID_KENSINGTON=y
CONFIG_HID_MICROSOFT=y
CONFIG_HID_MONTEREY=y
CONFIG_HID_PID=y
CONFIG_USB_HIDDEV=y
CONFIG_USB=y
CONFIG_USB_XHCI_HCD=y
CONFIG_USB_STORAGE=y
CONFIG_USB_DWC3=y
# CONFIG_USB_DWC3_HOST is not set
# CONFIG_USB_DWC3_GADGET is not set
CONFIG_USB_DWC3_DUAL_ROLE=y
# CONFIG_USB_DWC3_HAPS is not set
# CONFIG_USB_DWC3_OF_SIMPLE is not set
CONFIG_USB_GADGET=y
CONFIG_USB_CONFIGFS=y
CONFIG_USB_CONFIGFS_ACM=y
CONFIG_USB_CONFIGFS_RNDIS=y
CONFIG_USB_CONFIGFS_MASS_STORAGE=y
CONFIG_USB_CONFIGFS_F_UAC1=y
CONFIG_USB_CONFIGFS_F_UVC=y
CONFIG_MPP_TO_GADGET_UVC=y
CONFIG_MMC=y
CONFIG_MMC_SDHCI=y
CONFIG_MMC_SDHCI_NEBULA=y
CONFIG_MMC_SDHCI_PLTFM=y
CONFIG_MMC_QUICKBOOT=y
CONFIG_RTC_CLASS=y
CONFIG_RTC_DRV_BSP=y
CONFIG_DMADEVICES=y
# CONFIG_VIRTIO_MENU is not set
CONFIG_RESET_BSP=y
# CONFIG_FSL_ERRATUM_A008585 is not set
# CONFIG_IOMMU_SUPPORT is not set
CONFIG_PM_DEVFREQ=y
CONFIG_DEVFREQ_GOV_SIMPLE_ONDEMAND=y
CONFIG_GENERIC_PHY=y
CONFIG_REALTEK_PHY=y
CONFIG_VENDOR_USB_PHY=y
CONFIG_USB_MODE_OPTION=y
CONFIG_USB_DRD0_IN_DEVICE=y
CONFIG_TEE=y
CONFIG_OPTEE=y
CONFIG_SYNC_OPTEE_MEMORY_LAYOUT=y
CONFIG_OPTEE_DIR="../../optee/optee_os-3.20.0"
CONFIG_EXT4_FS=y
CONFIG_EXT4_FS_POSIX_ACL=y
CONFIG_EXT4_FS_SECURITY=y
CONFIG_XFS_FS=y
CONFIG_XFS_QUOTA=y
CONFIG_XFS_POSIX_ACL=y
CONFIG_XFS_RT=y
CONFIG_QUOTA=y
CONFIG_QFMT_V1=m
CONFIG_QFMT_V2=m
CONFIG_AUTOFS4_FS=m
CONFIG_FUSE_FS=y
CONFIG_ISO9660_FS=y
CONFIG_UDF_FS=y
CONFIG_MSDOS_FS=y
CONFIG_VFAT_FS=y
CONFIG_TMPFS=y
CONFIG_TMPFS_POSIX_ACL=y
CONFIG_CRAMFS=y
CONFIG_SQUASHFS=y
CONFIG_SQUASHFS_LZO=y
CONFIG_SQUASHFS_XZ=y
CONFIG_NFS_FS=y
CONFIG_NFS_V3_ACL=y
CONFIG_NLS_CODEPAGE_437=y
CONFIG_NLS_CODEPAGE_737=m
CONFIG_NLS_CODEPAGE_775=m
CONFIG_NLS_CODEPAGE_850=m
CONFIG_NLS_CODEPAGE_852=m
CONFIG_NLS_CODEPAGE_855=m
CONFIG_NLS_CODEPAGE_857=m
CONFIG_NLS_CODEPAGE_860=m
CONFIG_NLS_CODEPAGE_861=m
CONFIG_NLS_CODEPAGE_862=m
CONFIG_NLS_CODEPAGE_863=m
CONFIG_NLS_CODEPAGE_864=m
CONFIG_NLS_CODEPAGE_865=m
CONFIG_NLS_CODEPAGE_866=m
CONFIG_NLS_CODEPAGE_869=m
CONFIG_NLS_CODEPAGE_936=y
CONFIG_NLS_CODEPAGE_950=m
CONFIG_NLS_CODEPAGE_932=m
CONFIG_NLS_CODEPAGE_949=m
CONFIG_NLS_CODEPAGE_874=m
CONFIG_NLS_ISO8859_8=m
CONFIG_NLS_CODEPAGE_1250=m
CONFIG_NLS_CODEPAGE_1251=m
CONFIG_NLS_ASCII=y
CONFIG_NLS_ISO8859_1=y
CONFIG_NLS_ISO8859_2=m
CONFIG_NLS_ISO8859_3=m
CONFIG_NLS_ISO8859_4=m
CONFIG_NLS_ISO8859_5=m
CONFIG_NLS_ISO8859_6=m
CONFIG_NLS_ISO8859_7=m
CONFIG_NLS_ISO8859_9=m
CONFIG_NLS_ISO8859_13=m
CONFIG_NLS_ISO8859_14=m
CONFIG_NLS_ISO8859_15=m
CONFIG_NLS_KOI8_R=m
CONFIG_NLS_KOI8_U=m
CONFIG_NLS_UTF8=y
CONFIG_CRYPTO_CCM=m
CONFIG_CRYPTO_SEQIV=m
CONFIG_CRYPTO_ECHAINIV=m
CONFIG_CRYPTO_ECB=y
CONFIG_CRYPTO_CMAC=y
CONFIG_CRYPTO_SHA256=y
CONFIG_CRYPTO_AES=y
CONFIG_CRYPTO_DEFLATE=y
CONFIG_CRYPTO_LZO=y
CONFIG_CRYPTO_ZSTD=y
CONFIG_CRC_CCITT=y
CONFIG_DMA_CMA=y
CONFIG_CMA_SIZE_MBYTES=4
CONFIG_MAGIC_SYSRQ=y
CONFIG_PANIC_ON_OOPS=y
CONFIG_DETECT_HUNG_TASK=y
CONFIG_SCHEDSTATS=y
CONFIG_STACKTRACE=y
CONFIG_RCU_CPU_STALL_TIMEOUT=60
# CONFIG_FTRACE is not set
CONFIG_EXTCON=y

#
# Extcon Device Drivers
#
# CONFIG_EXTCON_FSA9480 is not set
# CONFIG_EXTCON_GPIO is not set
# CONFIG_EXTCON_MAX3355 is not set
# CONFIG_EXTCON_PTN5150 is not set
# CONFIG_EXTCON_RT8973A is not set
# CONFIG_EXTCON_SM5502 is not set
# CONFIG_EXTCON_USB_GPIO is not set
CONFIG_USB_WING=y

#
# Wing UPS Phy
#
CONFIG_WING_UPS_PHY=y
CONFIG_WING_UPS_XVP_PHY=y
# CONFIG_WING_UPS_NANO_PHY is not set
CONFIG_WING_UPS_MISSILE_PHY=y
# end of Wing UPS Phy

CONFIG_BASEDRV_CLK=y
```

## arch/arm64/configs/hi3519dv500_mini_defconfig
```kconfig
# CONFIG_SWAP is not set
CONFIG_SYSVIPC=y
CONFIG_USELIB=y
CONFIG_LOG_BUF_SHIFT=14
CONFIG_NAMESPACES=y
CONFIG_RELAY=y
CONFIG_BLK_DEV_INITRD=y
CONFIG_VENDOR_RAMDISK_ZERO_COPY=y
# CONFIG_FHANDLE is not set
# CONFIG_KALLSYMS is not set
CONFIG_BPF_SYSCALL=y
CONFIG_USERFAULTFD=y
CONFIG_EMBEDDED=y
# CONFIG_COMPAT_BRK is not set
CONFIG_ARCH_BSP=y
CONFIG_ARCH_HI3519DV500=y
CONFIG_SCHED_MC=y
CONFIG_NR_CPUS=2
CONFIG_HZ_100=y
CONFIG_CMDLINE="mem=128M console=ttyAMA0,115200 console=ttyMTD,blackbox"
# CONFIG_EFI is not set
CONFIG_BUILD_ARM64_APPENDED_DTB_IMAGE=y
CONFIG_BUILD_ARM64_APPENDED_DTB_IMAGE_NAMES="vendor/hi3519dv500-demb-flash"
CONFIG_CPU_FREQ=y
CONFIG_CPU_FREQ_STAT=y
CONFIG_CPU_FREQ_DEFAULT_GOV_USERSPACE=y
CONFIG_CPU_FREQ_GOV_PERFORMANCE=y
CONFIG_CPU_FREQ_GOV_POWERSAVE=y
CONFIG_CPU_FREQ_GOV_ONDEMAND=y
CONFIG_CPU_FREQ_GOV_CONSERVATIVE=y
CONFIG_CPUFREQ_DT=y
# CONFIG_SECCOMP is not set
CONFIG_MODULES=y
CONFIG_MODULE_UNLOAD=y
CONFIG_PARTITION_ADVANCED=y
CONFIG_CMDLINE_PARTITION=y
CONFIG_KSM=y
CONFIG_UEVENT_HELPER=y
CONFIG_UEVENT_HELPER_PATH="/sbin/hotplug"
CONFIG_DEVTMPFS=y
CONFIG_DEVTMPFS_MOUNT=y
# CONFIG_PREVENT_FIRMWARE_BUILD is not set
CONFIG_BLK_DEV_RAM=y
CONFIG_BLK_DEV_RAM_SIZE=65536
# CONFIG_LEGACY_PTYS is not set
CONFIG_SERIAL_AMBA_PL011=y
CONFIG_SERIAL_AMBA_PL011_CONSOLE=y
# CONFIG_HW_RANDOM is not set
# CONFIG_HWMON is not set
# CONFIG_HID is not set
# CONFIG_USB_SUPPORT is not set
# CONFIG_VIRTIO_MENU is not set
CONFIG_RESET_BSP=y
# CONFIG_FSL_ERRATUM_A008585 is not set
# CONFIG_IOMMU_SUPPORT is not set
CONFIG_TMPFS=y
CONFIG_TMPFS_POSIX_ACL=y
CONFIG_ROMFS_FS=y
CONFIG_PRINTK_TIME=y
CONFIG_CMD_TIMESTAMP=y
# CONFIG_SYMBOLIC_ERRNAME is not set
# CONFIG_DEBUG_BUGVERBOSE is not set
# CONFIG_DEBUG_MISC is not set
CONFIG_PANIC_ON_OOPS=y
CONFIG_DETECT_HUNG_TASK=y
CONFIG_RCU_CPU_STALL_TIMEOUT=60
# CONFIG_FTRACE is not set
```

## drivers/clk/vendor/Kconfig
```kconfig
config RESET_BSP
	bool "Vendor Reset Controller Driver"
	depends on ARCH_BSP || COMPILE_TEST || ARCH_BSP
	select RESET_CONTROLLER
	help
	  Build reset controller driver for Vendor device chipsets.
```

## drivers/edmac/Kconfig
```kconfig
#
# Sensor device configuration
#

config EDMAC
	tristate "Vendor EDMAC Controller support"
	depends on (ARCH_BSP && !EDMACV310)
	help
	  The Direction Memory Access(EDMA) is a high-speed data transfer
	  operation. It supports data read/write between peripherals and
	  memories without using the CPU.
	  Vendor EDMA Controller(EDMAC) directly transfers data between
	  a memory and a peripheral, between peripherals, or between memories.
	  This avoids the CPU intervention and reduces the interrupt handling
	  overhead of the CPU.

if EDMAC

config EDMAC_CHANNEL_NUM
	int "edmac channel num"
	default "8"

config EDMAC_INTERRUPT
	bool "Vendor EDMAC Controller interrupt mode support"
	depends on EDMAC
	help
	  open Vendor EDMAC Controller interrupt mode

endif
```

## drivers/misc/hisi-djtag/Kconfig
```kconfig
config HISI_DJTAG
	tristate "hisilicon djtag r/w interface via syscon"
	depends on ARM64 || COMPILE_TEST
	help
	  This enables support djtag r/w for some modules.
```

## drivers/mtd/nand/Kconfig
```kconfig
# SPDX-License-Identifier: GPL-2.0-only

menu "NAND"

config MTD_NAND_CORE
	tristate

source "drivers/mtd/nand/onenand/Kconfig"

config MTD_SPI_NAND_BSP
    tristate "Support for SPI NAND controller on Vendor SoCs"
    depends on MTD_RAW_NAND
    help
      Enables support for the SPI NAND device drivers.

config BSP_NAND_ECC_STATUS_REPORT
	tristate "Report the ecc status to MTD for Nand Driver"
	depends on MTD_RAW_NAND && ARCH_BSP
	default n
	help
	  Flash Memory Controller reports the ecc status include ECC error
	  and ECC corrected to MTD to monitor the aging of devices.

config BSP_NAND_FS_MAY_NO_YAFFS2
    bool "Remove the restraintion of 16bit ecc type on yaffs2 to Vendor"
	depends on MFD_BSP_FMC
    default n
    help
      The ecc type: 16bit is limited by the Vendor flash memory controller,
      as the yaffs2 tag of rootfs limits the min size of CTRL len is 28.

source "drivers/mtd/nand/raw/Kconfig"
source "drivers/mtd/nand/fmc100/Kconfig"
source "drivers/mtd/nand/fmc100_nand/Kconfig"
source "drivers/mtd/nand/spi/Kconfig"

menu "ECC engine support"

config MTD_NAND_ECC
       bool
       depends on MTD_NAND_CORE

endmenu

endmenu
```

## drivers/mtd/nand/fmc100/Kconfig
```kconfig
#
# vendor flash memory controller SPI nand device driver version 100
# drivers/mtd/nand/fmc100/Kconfig
#

config MTD_SPI_NAND_FMC100
	tristate "Vendor Flash Memory Controller v100 SPI Nand devices support"
	depends on MFD_BSP_FMC && MTD_SPI_NAND_BSP
	select MISC_FILESYSTEMS
	select MTD_BLOCK
	select YAFFS_FS
	select YAFFS_YAFFS2
	help
	  Vendor Flash Memory Controller version 100 is called fmc100 for
	  short. The controller driver support registers and DMA transfers
	  while reading or writing the SPI nand flash.
```
